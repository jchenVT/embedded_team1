// These arguments were used when this file was generated. They will be automatically applied on subsequent loads 
// via the GUI or CLI invocations. Run CLI with '--help' for additional information on how to override these arguments.
// @cliArgs --board "/ti/boards/CC3220SF_LAUNCHXL" --product "simplelink_cc32xx_sdk@3.40.00.05"
// @versions {"data":"2020022712","timestamp":"2020022712","tool":"1.3.1030","templates":"2020022712"}

var RTOS = scripting.addModule("/ti/drivers/RTOS");
var Timer = scripting.addModule("/ti/drivers/Timer");
var Timer1 = Timer.addInstance();
var UART = scripting.addModule("/ti/drivers/UART", {}, false);
var UART1 = UART.addInstance();
var Timer2 = Timer.addInstance();
var UART2 = UART.addInstance();
var I2C = scripting.addModule("/ti/drivers/I2C", {}, false);
var I2C1 = I2C.addInstance();
var GPIO = scripting.addModule("/ti/drivers/GPIO", {}, false);
var GPIO1 = GPIO.addInstance();
// name - Select the RTOS being used
RTOS.name = "FreeRTOS";
// Name - The C/C++ identifier used in applications as the index parameter passed to Timer runtime APIs
Timer1.$name = "CONFIG_TIMER_0";
// Timer Type
Timer1.timerType = "32 Bits";
// Interrupt Priority - Timer Interrupt Priority
Timer1.interruptPriority = "4";
var Power = scripting.addModule("/ti/drivers/Power", {}, false);
// Name
Power.parkPins.$name = "ti_drivers_power_PowerCC32XXPins0";
var Board = scripting.addModule("/ti/drivers/Board", {}, false);
var DriverLib = scripting.addModule("/ti/devices/DriverLib", {}, false);
// Name
Timer1.timer.$name = "MyTimer1";
// Use Peripheral
Timer1.timer.$assign = "Timer0";
// Name - The C/C++ identifier used in applications as the index parameter passed to UART runtime APIs
UART1.$name = "CONFIG_UART_0";
// Data Direction
UART1.dataDirection = "Send Only";
// Interrupt Priority - UART peripheral interrupt priority
UART1.interruptPriority = "5";
// Use Hardware - Select the hardware to use, or 'None' to use available header pins
UART1.$hardware = system.deviceData.board.components.XDS110UART;
// Name
UART1.uart.$name = "MyUART1";
// Use Peripheral
UART1.uart.$assign = "UART0";
// Assign pin
UART1.uart.txPin.$assign = "GP01"; // pin number - 55
// Name - The C/C++ identifier used in applications as the index parameter passed to Timer runtime APIs
Timer2.$name = "CONFIG_TIMER_1";
// Timer Type
Timer2.timerType = "32 Bits";
// Name
Timer2.timer.$name = "MyTimer1";
// Use Peripheral
Timer2.timer.$assign = "Timer1";
// Name - The C/C++ identifier used in applications as the index parameter passed to UART runtime APIs
UART2.$name = "CONFIG_UART_1";
// Use DMA
UART2.useDMA = true;
// Name
UART2.uart.$name = "MyUART1";
// Assign pin
UART2.uart.txPin.$assign = "boosterpack.15"; // P07
// Assign pin
UART2.uart.rxPin.$assign = "boosterpack.17"; // P45
var DMA = scripting.addModule("/ti/drivers/DMA", {}, false);
// Name - The C/C++ identifier used in applications as the index parameter passed to I2C runtime APIs
I2C1.$name = "CONFIG_I2C_0";
// Use Hardware - Select the hardware to use, or 'None' to use available header pins
I2C1.$hardware = system.deviceData.board.components.LP_I2C;
// Ignore Unused Address Conflicts - Don't warn about address conflicts between unused components on this bus
I2C1.ignoreUnusedAddressConflicts = true;
// Name
I2C1.i2c.$name = "MyI2C1";
// Use Peripheral
I2C1.i2c.$assign = "I2C0";
// Assign pin
I2C1.i2c.sdaPin.$assign = "boosterpack.10"; // P02
// Assign pin
I2C1.i2c.sclPin.$assign = "boosterpack.9"; // P01
// Name - The C/C++ identifier used in applications as the index parameter passed to GPIO runtime APIs
GPIO1.$name = "CONFIG_GPIO_0";
// Suggest solution
UART2.uart.$suggestSolution = "UART1";
// Suggest solution
UART2.uart.txDmaChannel.$suggestSolution = "UDMA_CH11";
// Suggest solution
UART2.uart.rxDmaChannel.$suggestSolution = "UDMA_CH10";
// Suggest solution
GPIO1.gpioPin.$suggestSolution = "3";
