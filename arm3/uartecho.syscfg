/**
 * @cliArgs --board "/ti/boards/CC3220SF_LAUNCHXL" --product "simplelink_cc32xx_sdk@4_10_00_07"
 * @versions {"data":"2020021217","timestamp":"2020021217","tool":"1.4.0+1234","templates":"2020021217"}
 */

/**
 * Import the modules used in this configuration.
 */
const Display        = scripting.addModule("/ti/display/Display", {}, false);
const Display1       = Display.addInstance();
const Crypto         = scripting.addModule("/ti/drivers/Crypto", {}, false);
const Crypto1        = Crypto.addInstance();
const GPIO           = scripting.addModule("/ti/drivers/GPIO", {}, false);
const GPIO1          = GPIO.addInstance();
const PWM            = scripting.addModule("/ti/drivers/PWM", {}, false);
const PWM1           = PWM.addInstance();
const PWM2           = PWM.addInstance();
const PWM3           = PWM.addInstance();
const PWM4           = PWM.addInstance();
const RTOS           = scripting.addModule("/ti/drivers/RTOS");
const SPI            = scripting.addModule("/ti/drivers/SPI");
const SPI1           = SPI.addInstance();
const UART           = scripting.addModule("/ti/drivers/UART");
const Watchdog       = scripting.addModule("/ti/drivers/Watchdog", {}, false);
const Watchdog1      = Watchdog.addInstance();
const SimpleLinkWifi = scripting.addModule("/ti/drivers/net/wifi/SimpleLinkWifi");

/**
 * Write custom configuration values to the imported modules.
 */
Display1.$name                          = "CONFIG_Display_0";
Display1.$hardware                      = system.deviceData.board.components.XDS110UART;
Display1.uart.$name                     = "CONFIG_UART_0";
Display1.uart.useDMA                    = true;
Display1.uart.uart.$name                = "MyUART1";
Display1.uart.uart.$assign              = "UART0";
Display1.uart.uart.txPin.$assign        = "GP01";
Display1.uart.uart.rxPin.$assign        = "GP02";
Display1.uart.uart.txDmaChannel.$assign = "UDMA_CH9";
Display1.uart.uart.rxDmaChannel.$assign = "UDMA_CH8";

Crypto1.$name = "CONFIG_Crypto_0";

GPIO1.$name = "CONFIG_GPIO_0";

PWM1.$name                = "CONFIG_PWM_0";
PWM1.$hardware            = system.deviceData.board.components.LED_YELLOW;
PWM1.timer.$name          = "MyTimer1";
PWM1.timer.$assign        = "Timer3";
PWM1.timer.pwmPin.$assign = "boosterpack.9";

PWM2.$name       = "CONFIG_PWM_1";
PWM2.$hardware   = system.deviceData.board.components.LED_GREEN;
PWM2.timer.$name = "MyTimer1";

PWM3.$name       = "CONFIG_PWM_2";
PWM3.timer.$name = "MyTimer1";

PWM4.$name       = "CONFIG_PWM_3";
PWM4.$hardware   = system.deviceData.board.components.LED_RED;
PWM4.timer.$name = "MyTimer1";

const Power               = scripting.addModule("/ti/drivers/Power", {}, false);
Power.ioRetentionShutdown = ["GRP_1"];
Power.parkPins.$name      = "ti_drivers_power_PowerCC32XXPins0";

RTOS.name = "FreeRTOS";

SPI1.$name                    = "CONFIG_SPI_0";
SPI1.mode                     = "Four Pin SS Active Low";
SPI1.spi.$name                = "MySPI1";
SPI1.spi.ssPin.$assign        = "boosterpack.18";
SPI1.spi.dmaRxChannel.$assign = "UDMA_CH6";
SPI1.spi.dmaTxChannel.$assign = "UDMA_CH7";

Watchdog1.$name            = "CONFIG_WATCHDOG_0";
Watchdog1.watchdog.$name   = "MyWATCHDOG1";
Watchdog1.watchdog.$assign = "WATCHDOG0";

/**
 * Pinmux solution for unlocked pins/peripherals. This ensures that minor changes to the automatic solver in a future
 * version of the tool will not impact the pinmux you originally saw.  These lines can be completely deleted in order to
 * re-solve from scratch.
 */
GPIO1.gpioPin.$suggestSolution     = "3";
PWM2.timer.$suggestSolution        = "Timer3";
PWM2.timer.pwmPin.$suggestSolution = "2";
PWM3.timer.$suggestSolution        = "Timer1";
PWM3.timer.pwmPin.$suggestSolution = "21";
PWM4.timer.$suggestSolution        = "Timer2";
PWM4.timer.pwmPin.$suggestSolution = "64";
SPI1.spi.$suggestSolution          = "SPI0";
SPI1.spi.sclkPin.$suggestSolution  = "5";
SPI1.spi.misoPin.$suggestSolution  = "6";
SPI1.spi.mosiPin.$suggestSolution  = "7";
