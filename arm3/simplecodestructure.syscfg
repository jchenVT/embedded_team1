// These arguments were used when this file was generated. They will be automatically applied on subsequent loads 
// via the GUI or CLI invocations. Run CLI with '--help' for additional information on how to override these arguments.
// @cliArgs --board "/ti/boards/CC3220SF_LAUNCHXL" --product "simplelink_cc32xx_sdk@3.30.01.02"
// @versions {"data":"2019103101","timestamp":"2019103101","tool":"1.3.1030","templates":"2019103101"}

var RTOS = scripting.addModule("/ti/drivers/RTOS");
var SimpleLinkWifi = scripting.addModule("/ti/drivers/net/wifi/SimpleLinkWifi");
var Crypto = scripting.addModule("/ti/drivers/Crypto", {}, false);
var Crypto1 = Crypto.addInstance();
var Display = scripting.addModule("/ti/display/Display", {}, false);
var Display1 = Display.addInstance();
var PWM = scripting.addModule("/ti/drivers/PWM", {}, false);
var PWM1 = PWM.addInstance();
var PWM2 = PWM.addInstance();
var PWM3 = PWM.addInstance();
var PWM4 = PWM.addInstance();
var GPIO = scripting.addModule("/ti/drivers/GPIO", {}, false);
var GPIO1 = GPIO.addInstance();
var SPI = scripting.addModule("/ti/drivers/SPI");
var SPI1 = SPI.addInstance();
var Watchdog = scripting.addModule("/ti/drivers/Watchdog", {}, false);
var Watchdog1 = Watchdog.addInstance();
var Timer = scripting.addModule("/ti/drivers/Timer", {}, false);
var Timer1 = Timer.addInstance();
// name - Select the RTOS being used
RTOS.name = "FreeRTOS";
// Name - The C/C++ identifier used in applications as the index parameter passed to Crypto runtime APIs
Crypto1.$name = "CONFIG_Crypto_0";
var Power = scripting.addModule("/ti/drivers/Power", {}, false);
// Name
Power.parkPins.$name = "ti_drivers_power_PowerCC32XXPins0";
var Board = scripting.addModule("/ti/drivers/Board", {}, false);
var DriverLib = scripting.addModule("/ti/devices/DriverLib", {}, false);
// Name - The C/C++ identifier used in applications as the index parameter passed to Display runtime APIs
Display1.$name = "CONFIG_Display_0";
// Use Hardware - Select the hardware to use, or 'None' to use available header pins
Display1.$hardware = system.deviceData.board.components.XDS110UART;
// Name - The C/C++ identifier used in applications as the index parameter passed to UART runtime APIs
Display1.uart.$name = "CONFIG_UART_0";
// Use DMA
Display1.uart.useDMA = true;
// Name
Display1.uart.uart.$name = "MyUART1";
// Use Peripheral
Display1.uart.uart.$assign = "UART0";
var DMA = scripting.addModule("/ti/drivers/DMA", {}, false);
// Name - The C/C++ identifier used in applications as the index parameter passed to PWM runtime APIs
PWM1.$name = "CONFIG_PWM_0";
// Use Hardware - Select the hardware to use, or 'None' to use available header pins
PWM1.$hardware = system.deviceData.board.components.LED_YELLOW;
// Name
PWM1.timer.$name = "MyTimer1";
// Use Peripheral
PWM1.timer.$assign = "Timer3";
// Assign pin
PWM1.timer.pwmPin.$assign = "boosterpack.9"; // P01
// Name - The C/C++ identifier used in applications as the index parameter passed to PWM runtime APIs
PWM2.$name = "CONFIG_PWM_1";
// Use Hardware - Select the hardware to use, or 'None' to use available header pins
PWM2.$hardware = system.deviceData.board.components.LED_GREEN;
// Name
PWM2.timer.$name = "MyTimer1";
// Name - The C/C++ identifier used in applications as the index parameter passed to PWM runtime APIs
PWM3.$name = "CONFIG_PWM_2";
// Name
PWM3.timer.$name = "MyTimer1";
// Name - The C/C++ identifier used in applications as the index parameter passed to PWM runtime APIs
PWM4.$name = "CONFIG_PWM_3";
// Use Hardware - Select the hardware to use, or 'None' to use available header pins
PWM4.$hardware = system.deviceData.board.components.LED_RED;
// Name
PWM4.timer.$name = "MyTimer1";
// Use Peripheral
PWM4.timer.$assign = "Timer2";
// Name - The C/C++ identifier used in applications as the index parameter passed to GPIO runtime APIs
GPIO1.$name = "CONFIG_GPIO_0";
// Name - The C/C++ identifier used in applications as the index parameter passed to SPI runtime APIs
SPI1.$name = "CONFIG_SPI_0";
// Mode - In three pin mode the SS signal is not used.
SPI1.mode = "Four Pin SS Active Low";
// Name
SPI1.spi.$name = "MySPI1";
// Assign pin
SPI1.spi.ssPin.$assign = "boosterpack.18"; // P08
// Assign pin
SPI1.spi.dmaRxChannel.$assign = "UDMA_CH6";
// Assign pin
SPI1.spi.dmaTxChannel.$assign = "UDMA_CH7";
// Name - The C/C++ identifier used in applications as the index parameter passed to Watchdog runtime APIs
Watchdog1.$name = "CONFIG_WATCHDOG_0";
// Name
Watchdog1.watchdog.$name = "MyWATCHDOG1";
// Use Peripheral
Watchdog1.watchdog.$assign = "WATCHDOG0";
// Name - The C/C++ identifier used in applications as the index parameter passed to Timer runtime APIs
Timer1.$name = "CONFIG_TIMER_0";
// Timer Type
Timer1.timerType = "32 Bits";
// Name
Timer1.timer.$name = "MyTimer1";
// Suggest solution
Display1.uart.uart.txPin.$suggestSolution = "55";
// Suggest solution
Display1.uart.uart.rxPin.$suggestSolution = "57";
// Suggest solution
Display1.uart.uart.txDmaChannel.$suggestSolution = "UDMA_CH9";
// Suggest solution
Display1.uart.uart.rxDmaChannel.$suggestSolution = "UDMA_CH8";
// Suggest solution
PWM2.timer.$suggestSolution = "Timer3";
// Suggest solution
PWM2.timer.pwmPin.$suggestSolution = "2";
// Suggest solution
PWM3.timer.$suggestSolution = "Timer1";
// Suggest solution
PWM3.timer.pwmPin.$suggestSolution = "21";
// Suggest solution
PWM4.timer.pwmPin.$suggestSolution = "64";
// Suggest solution
GPIO1.gpioPin.$suggestSolution = "3";
// Suggest solution
SPI1.spi.$suggestSolution = "SPI0";
// Suggest solution
SPI1.spi.sclkPin.$suggestSolution = "5";
// Suggest solution
SPI1.spi.misoPin.$suggestSolution = "6";
// Suggest solution
SPI1.spi.mosiPin.$suggestSolution = "7";
// Suggest solution
Timer1.timer.$suggestSolution = "Timer0";
