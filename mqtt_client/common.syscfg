// These arguments were used when this file was generated. They will be automatically applied on subsequent loads 
// via the GUI or CLI invocations. Run CLI with '--help' for additional information on how to override these arguments.
// @cliArgs --board "/ti/boards/CC3220SF_LAUNCHXL" --product "simplelink_cc32xx_sdk@3.30.01.02"
// @versions {"data":"2019103101","timestamp":"2019103101","tool":"1.3.1030","templates":"2019103101"}

var RTOS = scripting.addModule("/ti/drivers/RTOS");
var GPIO = scripting.addModule("/ti/drivers/GPIO");
var UART = scripting.addModule("/ti/drivers/UART", {}, false);
var UART1 = UART.addInstance();
var GPIO1 = GPIO.addInstance();
var GPIO2 = GPIO.addInstance();
var GPIO3 = GPIO.addInstance();
var GPIO4 = GPIO.addInstance();
var GPIO5 = GPIO.addInstance();
var GPIO6 = GPIO.addInstance();
var GPIO7 = GPIO.addInstance();
var GPIO8 = GPIO.addInstance();
var SPI = scripting.addModule("/ti/drivers/SPI");
var SPI1 = SPI.addInstance();
var GPIO9 = GPIO.addInstance();
var GPIO10 = GPIO.addInstance();
var GPIO11 = GPIO.addInstance();
var GPIO12 = GPIO.addInstance();
var GPIO13 = GPIO.addInstance();
var Timer = scripting.addModule("/ti/drivers/Timer", {}, false);
var Timer1 = Timer.addInstance();
var Timer2 = Timer.addInstance();
var Timer3 = Timer.addInstance();
var Watchdog = scripting.addModule("/ti/drivers/Watchdog", {}, false);
var Watchdog1 = Watchdog.addInstance();
var Crypto = scripting.addModule("/ti/drivers/Crypto", {}, false);
var Crypto1 = Crypto.addInstance();
// name - Select the RTOS being used
RTOS.name = "FreeRTOS";
var Power = scripting.addModule("/ti/drivers/Power", {}, false);
// Name
Power.parkPins.$name = "ti_drivers_power_PowerCC32XXPins0";
var Board = scripting.addModule("/ti/drivers/Board", {}, false);
var DriverLib = scripting.addModule("/ti/devices/DriverLib", {}, false);
// Name - The C/C++ identifier used in applications as the index parameter passed to UART runtime APIs
UART1.$name = "CONFIG_UART_0";
// Data Direction
UART1.dataDirection = "Send Only";
// Interrupt Priority - UART peripheral interrupt priority
UART1.interruptPriority = "5";
// Name
UART1.uart.$name = "MyUART1";
// Use Peripheral
UART1.uart.$assign = "UART0";
// Assign pin
UART1.uart.txPin.$assign = "boosterpack.8"; // P62
// Mode - Select the GPIO mode
GPIO1.mode = "Output";
// Name - The C/C++ identifier used in applications as the index parameter passed to GPIO runtime APIs
GPIO1.$name = "CONFIG_GPIO_TOGGLE";
// Assign pin
GPIO1.gpioPin.$assign = "boosterpack.5"; // P61
// Mode - Select the GPIO mode
GPIO2.mode = "Output";
// Name - The C/C++ identifier used in applications as the index parameter passed to GPIO runtime APIs
GPIO2.$name = "CONFIG_GPIO_0";
// Assign pin
GPIO2.gpioPin.$assign = "boosterpack.4"; // P03
// Mode - Select the GPIO mode
GPIO3.mode = "Output";
// Name - The C/C++ identifier used in applications as the index parameter passed to GPIO runtime APIs
GPIO3.$name = "CONFIG_GPIO_1";
// Assign pin
GPIO3.gpioPin.$assign = "boosterpack.9"; // P01
// Mode - Select the GPIO mode
GPIO4.mode = "Output";
// Name - The C/C++ identifier used in applications as the index parameter passed to GPIO runtime APIs
GPIO4.$name = "CONFIG_GPIO_2";
// Assign pin
GPIO4.gpioPin.$assign = "boosterpack.10"; // P02
// Mode - Select the GPIO mode
GPIO5.mode = "Output";
// Name - The C/C++ identifier used in applications as the index parameter passed to GPIO runtime APIs
GPIO5.$name = "CONFIG_GPIO_3";
// Use Hardware - Select the hardware to use, or 'None' to use available header pins
GPIO5.$hardware = system.deviceData.board.components.LED_RED;
// Mode - Select the GPIO mode
GPIO6.mode = "Output";
// Name - The C/C++ identifier used in applications as the index parameter passed to GPIO runtime APIs
GPIO6.$name = "CONFIG_GPIO_4";
// Assign pin
GPIO6.gpioPin.$assign = "boosterpack.27"; // P63
// Mode - Select the GPIO mode
GPIO7.mode = "Output";
// Name - The C/C++ identifier used in applications as the index parameter passed to GPIO runtime APIs
GPIO7.$name = "CONFIG_GPIO_5";
// Assign pin
GPIO7.gpioPin.$assign = "boosterpack.14"; // P06
// Mode - Select the GPIO mode
GPIO8.mode = "Output";
// Name - The C/C++ identifier used in applications as the index parameter passed to GPIO runtime APIs
GPIO8.$name = "CONFIG_GPIO_6";
// Assign pin
GPIO8.gpioPin.$assign = "boosterpack.30"; // P50
var DMA = scripting.addModule("/ti/drivers/DMA", {}, false);
// Name - The C/C++ identifier used in applications as the index parameter passed to SPI runtime APIs
SPI1.$name = "CONFIG_SPI_MASTER";
// Name
SPI1.spi.$name = "MySPI1";
// Assign pin
SPI1.spi.sclkPin.$assign = "boosterpack.7"; // P05
// Assign pin
SPI1.spi.misoPin.$assign = "boosterpack.28"; // P53
// Assign pin
SPI1.spi.mosiPin.$assign = "boosterpack.15"; // P07
// Name - The C/C++ identifier used in applications as the index parameter passed to GPIO runtime APIs
GPIO9.$name = "CONFIG_SPI_MASTER_READY";
// Mode - Select the GPIO mode
GPIO9.mode = "Dynamic";
// Assign pin
GPIO9.gpioPin.$assign = "boosterpack.13"; // P21
// Name - The C/C++ identifier used in applications as the index parameter passed to GPIO runtime APIs
GPIO10.$name = "CONFIG_SPI_SLAVE128_READY";
// Mode - Select the GPIO mode
GPIO10.mode = "Dynamic";
// Assign pin
GPIO10.gpioPin.$assign = "boosterpack.19"; // P18
// Name - The C/C++ identifier used in applications as the index parameter passed to GPIO runtime APIs
GPIO11.$name = "CONFIG_SPI_SLAVE129_READY";
// Mode - Select the GPIO mode
GPIO11.mode = "Dynamic";
// Assign pin
GPIO11.gpioPin.$assign = "boosterpack.18"; // P08
// Name - The C/C++ identifier used in applications as the index parameter passed to GPIO runtime APIs
GPIO12.$name = "CONFIG_SPI_SLAVE130_READY";
// Assign pin
GPIO12.gpioPin.$assign = "boosterpack.24"; // P60
// Name - The C/C++ identifier used in applications as the index parameter passed to GPIO runtime APIs
GPIO13.$name = "CONFIG_GPIO_7";
// Use Hardware - Select the hardware to use, or 'None' to use available header pins
GPIO13.$hardware = system.deviceData.board.components.SW3;
// Name - The C/C++ identifier used in applications as the index parameter passed to Timer runtime APIs
Timer1.$name = "CONFIG_TIMER_0";
// Name
Timer1.timer.$name = "MyTimer1";
// Name - The C/C++ identifier used in applications as the index parameter passed to Timer runtime APIs
Timer2.$name = "CONFIG_TIMER_1";
// Name
Timer2.timer.$name = "MyTimer1";
// Name - The C/C++ identifier used in applications as the index parameter passed to Timer runtime APIs
Timer3.$name = "CONFIG_TIMER_2";
// Name
Timer3.timer.$name = "MyTimer1";
// Name - The C/C++ identifier used in applications as the index parameter passed to Watchdog runtime APIs
Watchdog1.$name = "CONFIG_WATCHDOG_0";
// Name
Watchdog1.watchdog.$name = "MyWATCHDOG1";
// Name - The C/C++ identifier used in applications as the index parameter passed to Crypto runtime APIs
Crypto1.$name = "CONFIG_Crypto_0";
// Suggest solution
GPIO5.gpioPin.$suggestSolution = "64";
// Suggest solution
SPI1.spi.$suggestSolution = "SPI0";
// Suggest solution
SPI1.spi.dmaRxChannel.$suggestSolution = "UDMA_CH30";
// Suggest solution
SPI1.spi.dmaTxChannel.$suggestSolution = "UDMA_CH31";
// Suggest solution
GPIO13.gpioPin.$suggestSolution = "15";
// Suggest solution
Timer1.timer.$suggestSolution = "Timer1";
// Suggest solution
Timer2.timer.$suggestSolution = "Timer0";
// Suggest solution
Timer3.timer.$suggestSolution = "Timer0";
// Suggest solution
Watchdog1.watchdog.$suggestSolution = "WATCHDOG0";
